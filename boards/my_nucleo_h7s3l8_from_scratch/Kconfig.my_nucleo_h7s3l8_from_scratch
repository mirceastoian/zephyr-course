## boards/my_nucleo_h7s3l8_from_scratch/board.yml
```yaml
board:
  name: my_nucleo_h7s3l8_from_scratch
  full_name: My board from scratch (using Nucleo H7S3L8)
  vendor: mircea
  socs:
    - name: stm32h7s3xx
```

## modules/my-led-driver/drivers/my-led-driver/Kconfig
```kconfig
menuconfig MY_LED_DRIVER
    bool "My LED Driver"
    default y
    depends on DT_HAS_MIRCEA_MY_LED_DRIVER_ENABLED
    select GPIO
    help
      This is a simple LED driver for demonstration purposes.
```

## modules/my-led-driver/dts/bindings/mircea,my-led-driver.yaml
```yaml
description: My LED Driver
compatible: "mircea,my-led-driver"
include: [base.yaml]
properties:
  gpios:
    type: phandle-array
    required: true
    description: GPIO of the LED
```
